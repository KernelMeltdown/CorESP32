## main/Kconfig.projbuild
```kconfig
menu "CorESP32 Configuration"

config CORESP32_MAIN_TASK_STACK_SIZE
    int "Main task stack size"
    default 5120
    range 2048 16384
    help
        Stack size for main task (app_main).
        Increase if you get stack overflow errors.

endmenu
```

## sdkconfig.defaults
```kconfig
# CorESP32 SDK Configuration

CONFIG_IDF_TARGET="esp32c6"
CONFIG_ESP_MAIN_TASK_STACK_SIZE=8192

# Serial Console - USB-SERIAL-JTAG FIX
CONFIG_ESP_CONSOLE_USB_SERIAL_JTAG=y
CONFIG_ESP_CONSOLE_SECONDARY_USB_SERIAL_JTAG=y
CONFIG_ESP_CONSOLE_UART_NUM=-1

# Partition Table
CONFIG_PARTITION_TABLE_CUSTOM=y
CONFIG_PARTITION_TABLE_CUSTOM_FILENAME="partitions.csv"
CONFIG_PARTITION_TABLE_FILENAME="partitions.csv"
CONFIG_PARTITION_TABLE_OFFSET=0x8000

# LittleFS
CONFIG_LITTLEFS_MAX_PARTITIONS=3
CONFIG_LITTLEFS_PAGE_SIZE=256
CONFIG_LITTLEFS_OBJ_NAME_LEN=64
CONFIG_LITTLEFS_READ_SIZE=128
CONFIG_LITTLEFS_WRITE_SIZE=128
CONFIG_LITTLEFS_LOOKAHEAD_SIZE=128
CONFIG_LITTLEFS_CACHE_SIZE=512
CONFIG_LITTLEFS_BLOCK_CYCLES=512

# Memory
CONFIG_ESP_SYSTEM_MEMPROT_FEATURE=y

# Logging
CONFIG_LOG_DEFAULT_LEVEL_INFO=y
CONFIG_LOG_MAXIMUM_LEVEL_DEBUG=y

# FreeRTOS
CONFIG_FREERTOS_HZ=1000
CONFIG_FREERTOS_USE_TRACE_FACILITY=y
CONFIG_FREERTOS_USE_STATS_FORMATTING_FUNCTIONS=y

# Optimization
CONFIG_COMPILER_OPTIMIZATION_SIZE=y

# Task Watchdog
CONFIG_ESP_TASK_WDT_INIT=n
```
